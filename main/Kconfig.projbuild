## main/Kconfig.projbuild
```kconfig
menu "PPM-MC-IOT App Config"

config PPM_IOT_CENTRAL_URL
	string "PPM IoT Central api url"
	help
		URL to the IoT central web service for device config

config PPM_IOT_CENTRAL_SECRET
	string "PPM IoT Central secret key"
	help
		Secret key to access the IoT Central web service api				
			
config PPM_IOT_WIFI_MAX_RETRY
	int "PPM IoT connect WiFi maximum retry count"
	default 10
	help
		Maximum retry count to connect to WiFi network				

config PPM_IOT_REBOOT_DELAY
	int "PPM IoT reboot delay"
	default 10
	help
		Delay in seconds before rebooting the chip				

config PPM_IOT_HEARTBEAT_INTERVALL
	int "PPM IoT heartbeat time interval"
	default 600
	help
		Intervall seconds to send heartbeat status message to iot event hub

config PPM_IOT_HARDWARE_VERSION
	int "PPM IoT hardware version"
	default 2402
	help
		PPM IoT PCB Version
		
config PPM_IOT_PROTOCOL
	choice 
		bool "IoT event hub communication protocol"
		default PPM_IOT_MQTT_WEBSOCKETS
		help
			IoT protocol to use, MQTT or MQTT_WEBSOCKETS
			
		config PPM_IOT_MQTT
			bool "Use MQTT protocol"
		config PPM_IOT_MQTT_WEBSOCKETS
			bool "Use MQTT Websockets protocol"
	endchoice

endmenu
```
